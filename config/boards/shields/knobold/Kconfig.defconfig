## config/boards/shields/knobold/Kconfig.defconfig
```kconfig
if SHIELD_KNOBOLD

config ZMK_KEYBOARD_NAME
    default "Knobold"

endif
CONFIG_EC11=y
CONFIG_EC11_TRIGGER_GLOBAL_THREAD=y
```

## config/boards/shields/knobold/Kconfig.shield
```kconfig
config SHIELD_KNOBOLD
    def_bool $(shields_list_contains,Knobold)
CONFIG_EC11=y
CONFIG_EC11_TRIGGER_GLOBAL_THREAD=y
```

## config/west.yml
```yaml
manifest:
  defaults:
    remote: zmkfirmware
  remotes:
    - name: zmkfirmware
      url-base: https://github.com/zmkfirmware
  projects:
    - name: zmk
      path: zmk
      remote: zmkfirmware
      revision: main
  self:
    path: config
    west-commands: zmk/west/west-commands.yml
```
